## zephyr/Kconfig
```kconfig
config MQTT_MIN_BROKER
	bool "Minimal MQTT broker"
	depends on NETWORKING && NET_TCP && NET_SOCKETS
	help
	  Enable the minimal MQTT v3.1.1 broker library.
	  Provides broker_init() and broker_run(); the caller is
	  responsible for bringing up the network interface before
	  calling broker_init().

if MQTT_MIN_BROKER

config MQTT_MAX_CLIENTS
	int "Maximum concurrent MQTT clients"
	default 8
	range 1 32
	help
	  Maximum simultaneous MQTT clients. Smaller embedded targets can lower this
	  to reduce client state and per-client stack allocation.

config MQTT_ADMISSION_MAX_CLIENTS
	int "Maximum locally admitted MQTT clients"
	default MQTT_MAX_CLIENTS
	range 1 32
	help
	  Maximum MQTT clients this broker will admit locally before returning
	  CONNACK server-unavailable to new connections. Keep this lower than
	  MQTT_MAX_CLIENTS to reserve resources for bridge forwarding and make
	  clients fall back to another broker.

config MQTT_CLIENT_STACK_SIZE
	int "Per MQTT client thread stack size"
	default 8192
	range 3072 16384
	help
	  Stack reserved for each admitted MQTT client thread on Zephyr.
	  Lower this on constrained products after validating pub/sub workloads.

config MQTT_STANDALONE
	bool "Include built-in main() and WiFi init"
	depends on WIFI
	default n
	help
	  Compile src/main.c and src/wifi.c so this module boots
	  on its own.  Leave n when embedding into an existing app
	  that provides its own main() and WiFi setup.

menu "WiFi (standalone only)"
	depends on MQTT_STANDALONE

config MQTT_WIFI_SSID
	string "WiFi SSID"
	default ""

config MQTT_WIFI_PASSWORD
	string "WiFi Password"
	default ""

choice MQTT_WIFI_IP_MODE
	prompt "IP address mode"
	default MQTT_WIFI_DHCP

config MQTT_WIFI_DHCP
	bool "DHCP"

config MQTT_WIFI_STATIC
	bool "Static IP"

endchoice

if MQTT_WIFI_STATIC

config MQTT_WIFI_STATIC_ADDR
	string "Static IP address"
	default "192.168.1.100"

config MQTT_WIFI_STATIC_NETMASK
	string "Netmask"
	default "255.255.255.0"

config MQTT_WIFI_STATIC_GW
	string "Gateway"
	default "192.168.1.1"

endif # MQTT_WIFI_STATIC

endmenu

menu "HTTP Dashboard (Linux only)"

config MQTT_HTTP_DASHBOARD
	bool "Enable HTTP status dashboard"
	default n
	help
	  Start a minimal HTTP server on port 8080.  Only compiled on
	  Linux/POSIX; this option has no effect on Zephyr targets.

endmenu

menu "Dynamic broker P2P"

config MQTT_P2P_DYNAMIC
	bool "Enable dynamic broker/router election"
	default n
	help
	  Enable UDP discovery, resource-weighted router election, and
	  TCP inter-node routing on port 4884.  Leave disabled for a
	  normal standalone MQTT broker.

config MQTT_P2P_STATIC_SEEDS_ONLY
	bool "Use only configured static P2P seeds"
	depends on MQTT_P2P_DYNAMIC
	default n
	help
	  Disable discovery-driven outbound peer selection.  Use this for
	  networks where UDP broadcast is unavailable; the embedder should
	  call p2p_static_seed_add() before broker_run().

config MQTT_P2P_PEER_MAX
	int "Maximum dynamic P2P peers"
	depends on MQTT_P2P_DYNAMIC
	default 5
	range 1 32
	help
	  Maximum simultaneous inter-broker P2P connections. Lower this on
	  RAM-constrained targets to reduce peer state, route tables, and
	  per-peer thread stack allocation.

config MQTT_P2P_CONNECT_MS
	int "P2P connection maintenance interval"
	depends on MQTT_P2P_DYNAMIC
	default 3000
	range 1000 60000
	help
	  Base interval for P2P connection maintenance. Static seed reconnects
	  use this as the initial retry delay.

config MQTT_P2P_CONNECT_BACKOFF_MAX_MS
	int "P2P static seed reconnect backoff limit"
	depends on MQTT_P2P_DYNAMIC
	default 30000
	range 3000 300000
	help
	  Maximum per-seed retry delay after repeated static seed connection
	  failures. This reduces connection storms when several embedded nodes
	  boot or recover at the same time.

config MQTT_P2P_REMOTE_SUBS_PER_NODE
	int "Remote subscriptions tracked per P2P node"
	depends on MQTT_P2P_DYNAMIC
	default 8
	range 1 64
	help
	  Number of remote subscriptions retained for each known P2P node.
	  Exact and wildcard route table sizes scale with this value.

config MQTT_P2P_SHARD_OWNER_CACHE_SIZE
	int "Shard owner cache entries"
	depends on MQTT_P2P_DYNAMIC
	default 256
	range 8 1024
	help
	  Number of cached topic-shard owner lookups. Lower values reduce
	  static RAM at the cost of more frequent owner recomputation.

endmenu

menu "Auth"

config MQTT_AUTH_ENABLED
	bool "Require username/password on CONNECT"
	default n

if MQTT_AUTH_ENABLED

config MQTT_AUTH_USERNAME
	string "Required username"
	default "admin"

config MQTT_AUTH_PASSWORD
	string "Required password"
	default ""

endif # MQTT_AUTH_ENABLED

endmenu

endif # MQTT_MIN_BROKER
```
