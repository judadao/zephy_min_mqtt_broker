## CMakeLists.txt
```
# Standalone app build (west build -b esp32 .)
# For module use, Zephyr picks up zephyr/CMakeLists.txt automatically.
cmake_minimum_required(VERSION 3.20.0)
find_package(Zephyr REQUIRED HINTS $ENV{ZEPHYR_BASE})
project(mqtt_min_broker)

target_sources(app PRIVATE
  src/broker.c
  src/client.c
  src/packet.c
  src/topic.c
  src/session.c
  src/main.c
  src/wifi.c
)

if(CONFIG_MQTT_P2P_DYNAMIC)
  target_sources(app PRIVATE
    src/p2p_discover.c
    src/p2p_election.c
    src/p2p_peer.c
    src/p2p_router.c
    src/p2p_shard.c
  )
endif()

target_include_directories(app PRIVATE include ${CMAKE_CURRENT_SOURCE_DIR})
```

## Kconfig
```
mainmenu "MQTT Minimal Broker"

source "Kconfig.zephyr"

menu "WiFi"

config MQTT_WIFI_SSID
    string "WiFi SSID"
    default ""
    help
      WiFi network name (2.4 GHz, WPA2-PSK).

config MQTT_WIFI_PASSWORD
    string "WiFi Password"
    default ""
    help
      WPA2-PSK passphrase for the above SSID.

choice MQTT_WIFI_IP_MODE
    prompt "IP address mode"
    default MQTT_WIFI_DHCP

config MQTT_WIFI_DHCP
    bool "DHCP"
    help
      Obtain IP address automatically via DHCP.

config MQTT_WIFI_STATIC
    bool "Static IP"
    help
      Assign a fixed IP address at boot.

endchoice

if MQTT_WIFI_STATIC

config MQTT_WIFI_STATIC_ADDR
    string "Static IP address"
    default "192.168.1.100"

config MQTT_WIFI_STATIC_NETMASK
    string "Netmask"
    default "255.255.255.0"

config MQTT_WIFI_STATIC_GW
    string "Gateway"
    default "192.168.1.1"

endif # MQTT_WIFI_STATIC

endmenu

menu "HTTP Dashboard"

config MQTT_HTTP_DASHBOARD
    bool "Enable HTTP status dashboard (Linux only)"
    default n
    help
      Start a minimal HTTP server on port 8080 serving a status
      dashboard (GET /) and REST API (GET /api/status,
      POST /api/publish).  Not available on Zephyr targets.

endmenu

menu "Dynamic broker P2P"

config MQTT_P2P_DYNAMIC
    bool "Enable dynamic broker/router election"
    default n
    help
      Enable UDP discovery, resource-weighted router election, and
      TCP inter-node routing on port 4884. Leave disabled for a
      normal standalone MQTT broker.

config MQTT_P2P_STATIC_SEEDS_ONLY
    bool "Use only configured static P2P seeds"
    depends on MQTT_P2P_DYNAMIC
    default n
    help
      Disable discovery-driven outbound peer selection. Use this for
      networks where UDP broadcast is unavailable; the embedder should
      call p2p_static_seed_add() before broker_run().

endmenu

menu "Auth"

config MQTT_AUTH_ENABLED
    bool "Require username/password on CONNECT"
    default n

if MQTT_AUTH_ENABLED

config MQTT_AUTH_USERNAME
    string "Required username"
    default "admin"

config MQTT_AUTH_PASSWORD
    string "Required password"
    default ""

endif # MQTT_AUTH_ENABLED

endmenu
```

## prj.conf
```kconfig
# Networking
CONFIG_NETWORKING=y
CONFIG_NET_TCP=y
CONFIG_NET_SOCKETS=y
CONFIG_NET_IPV4=y
CONFIG_NET_IPV6=n

# WiFi (ESP32) — ESP32_WIFI is auto-selected by the board when WIFI=y
CONFIG_WIFI=y
CONFIG_NET_L2_WIFI_MGMT=y
CONFIG_NET_DHCPV4=y

# WiFi credentials — fill in before flashing, do not commit secrets
CONFIG_MQTT_WIFI_SSID=""
CONFIG_MQTT_WIFI_PASSWORD=""
CONFIG_MQTT_WIFI_DHCP=y

# Memory
CONFIG_HEAP_MEM_POOL_SIZE=32768
CONFIG_MAIN_STACK_SIZE=4096
CONFIG_SYSTEM_WORKQUEUE_STACK_SIZE=2048

# Logging
CONFIG_LOG=y
CONFIG_LOG_DEFAULT_LEVEL=3
CONFIG_PRINTK=y
```

## src/main.c
```c
#include "platform/platform.h"
#include "broker.h"
#include "client.h"
#include "wifi.h"
#if defined(CONFIG_MQTT_HTTP_DASHBOARD) && !defined(__ZEPHYR__)
#include "http.h"
#endif
#if defined(CONFIG_MQTT_P2P_DYNAMIC)
#include "p2p.h"
#endif

LOG_MODULE_REGISTER(mqtt_main, LOG_LEVEL_INF);

int main(void)
{
    LOG_INF("MQTT minimal broker starting");

#ifdef __ZEPHYR__
    if (wifi_connect() != 0) {
        LOG_ERR("WiFi init failed, halting");
        return -1;
    }
#endif

    client_pool_init();

    if (broker_init() != 0) {
        LOG_ERR("broker_init failed");
        return -1;
    }

#if defined(CONFIG_MQTT_HTTP_DASHBOARD) && !defined(__ZEPHYR__)
    if (http_server_start(8080) != 0) {
        LOG_ERR("HTTP dashboard start failed");
    }
#endif

#if defined(CONFIG_MQTT_P2P_DYNAMIC)
    p2p_start();
#endif

    broker_run(); /* does not return */
    return 0;
}
```

## include/broker.h
```c
#ifndef BROKER_H
#define BROKER_H

#include <stdint.h>

#include "packet.h"

#ifndef MQTT_BROKER_PORT
#define MQTT_BROKER_PORT   1883
#endif

#ifndef MQTT_MAX_CLIENTS
#define MQTT_MAX_CLIENTS   8
#endif

#ifndef MQTT_ADMISSION_MAX_CLIENTS
#define MQTT_ADMISSION_MAX_CLIENTS MQTT_MAX_CLIENTS
#endif

typedef void (*broker_activity_cb_t)(void *ctx);

/*
 * Public broker lifecycle for standalone and embedded use.
 *
 * The embedder is responsible for bringing up the network interface before
 * broker_init(). On Zephyr this usually means connecting WiFi or Ethernet and
 * waiting for an assigned IP address. broker_init() initializes broker-owned
 * state and opens the listening socket; it returns 0 on success or a negative
 * error code on failure. Do not call broker_run() after a failed init.
 *
 * broker_run() enters the accept loop and does not return during normal
 * operation. It owns client allocation and per-client thread startup. When
 * CONFIG_MQTT_P2P_DYNAMIC is enabled, dynamic P2P routing is started by the
 * broker path; embedders do not need a separate P2P init call.
 *
 * broker_set_bind_host() optionally restricts the MQTT listener to one IPv4
 * address before broker_init(). Passing NULL or an empty string restores the
 * default INADDR_ANY behavior.
 *
 * broker_set_admission_limit() optionally caps the number of local MQTT clients
 * accepted by this broker. New CONNECT attempts beyond the limit receive
 * CONNACK SERVER_UNAVAILABLE so clients can fall back to another bridge broker.
 * Passing 0 restores the compile-time default.
 *
 * broker_set_activity_callback() registers a lightweight callback that is
 * invoked after a publish is accepted into the local topic router. It is meant
 * for embedders that need activity indicators and must not block.
 */
int  broker_set_bind_host(const char *host);
int  broker_set_listen_port(uint16_t port);
int  broker_set_admission_limit(uint16_t max_clients);
void broker_set_activity_callback(broker_activity_cb_t cb, void *ctx);
void broker_notify_activity(void);
void broker_mesh_ingress_publish_remote(const mqtt_publish_t *pub);
int  broker_init(void);
int  broker_stop_mqtt_listener(void);
int  broker_start_mqtt_listener(void);
int  broker_start_mesh_ingress_listener(uint16_t port);
void broker_run(void);

#endif /* BROKER_H */
```

## include/client.h
```c
#ifndef CLIENT_H
#define CLIENT_H

#include "platform/platform.h"
#include "packet.h"

#ifdef __ZEPHYR__
#ifndef CLIENT_STACK_SIZE
#define CLIENT_STACK_SIZE        8192
#endif
#else
#define CLIENT_STACK_SIZE        2048
#endif
#define CLIENT_INFLIGHT_MAX      4
#define CLIENT_INFLIGHT_RETRY_MS 5000
#define CLIENT_QOS2_IN_MAX       4   /* max simultaneous inbound QoS-2 publishes */

typedef struct {
    uint16_t packet_id;
    uint8_t  buf[MQTT_MAX_PACKET_SIZE + 8];
    uint16_t len;
    int64_t  sent_at_ms;
    uint8_t  in_use;
    uint8_t  qos;
    uint8_t  waiting_pubcomp; /* QoS 2 outbound: 0=sent PUBLISH, 1=sent PUBREL */
} inflight_t;

typedef struct {
    uint16_t packet_id;
    uint8_t  in_use;
} qos2_in_t;

typedef enum {
    CLIENT_STATE_FREE = 0,
    CLIENT_STATE_CONNECTED,
    CLIENT_STATE_DISCONNECTING,
} client_state_t;

typedef struct client {
    int              fd;
    client_state_t   state;
    uint8_t          slot;          /* index in pool, stable for lifetime */

    char             client_id[MQTT_CLIENT_ID_MAX];
    uint8_t          clean_session;
    uint16_t         keepalive;     /* seconds; 0 = disabled */
    int64_t          last_seen_ms;  /* k_uptime_get() at last packet */

    mqtt_publish_t   will;
    uint8_t          has_will;

    uint16_t         next_packet_id; /* incremented per QoS-1/2 outbound */
    inflight_t       inflight[CLIENT_INFLIGHT_MAX];
    qos2_in_t        qos2_in[CLIENT_QOS2_IN_MAX]; /* inbound QoS-2 dedup table */

    plat_thread_t    thread;
} client_t;

typedef struct {
    uint8_t  slot;
    char     client_id[MQTT_CLIENT_ID_MAX];
    uint16_t keepalive;
    int64_t  last_seen_ms;
} client_snapshot_t;

/*
 * Client-pool snapshot APIs for dashboards and embedders.
 *
 * client_get_snapshots() copies up to max connected clients into out and
 * returns the number written. client_free_slots() returns the number of
 * currently available client slots in the fixed pool.
 */
int  client_get_snapshots(client_snapshot_t *out, int max);
int  client_free_slots(void);
int  client_used_slots(void);

/*
 * Client-pool lifecycle and per-client worker entry points.
 *
 * client_pool_init() must run during broker initialization before accepting
 * sockets. client_alloc() claims a fixed client slot, initializes it, and starts
 * the platform thread that runs client_thread_fn(); it returns the slot index or
 * -1 when the pool is full. client_free() releases the socket, publishes any
 * pending Will message, persists subscriptions for non-clean sessions, and
 * returns the slot to the pool.
 */
void client_pool_init(void);
int  client_alloc(int fd);
void client_free(client_t *c);
void client_thread_fn(void *p1, void *p2, void *p3);

/*
 * Internal client helpers used by topic/session code. client_send() returns 0
 * when the full frame is sent or -1 on socket error. Inflight helpers manage
 * fixed QoS 1/2 retransmit slots for outbound publishes.
 */
int  client_send(client_t *c, const uint8_t *buf, size_t len);
void client_disconnect(client_t *c);
void client_inflight_store(client_t *c, uint16_t id, const uint8_t *buf, uint16_t len, uint8_t qos);
void client_inflight_ack(client_t *c, uint16_t id);
void client_inflight_retry(client_t *c);

#endif /* CLIENT_H */
```

## include/http.h
```c
#ifndef HTTP_H
#define HTTP_H

#ifndef __ZEPHYR__
/*
 * Linux-only dashboard lifecycle.
 *
 * http_server_start() starts the optional status/dashboard server on port and
 * returns 0 on success or a negative error code on failure. The dashboard reads
 * broker snapshots through public snapshot APIs; it does not own broker state.
 * http_server_stop() stops the dashboard listener when enabled.
 */
int  http_server_start(uint16_t port);
void http_server_stop(void);
#endif

#endif /* HTTP_H */
```

## include/p2p.h
```c
#ifndef P2P_H
#define P2P_H

#include <stdint.h>
#include "packet.h"

#define P2P_NODE_ID_LEN        16
#ifndef P2P_PORT
#define P2P_PORT              4884
#endif
#ifndef P2P_DISCOVERY_PORT
#define P2P_DISCOVERY_PORT    4885
#endif
#ifndef P2P_PEER_MAX
#ifdef __ZEPHYR__
#define P2P_PEER_MAX          5
#else
#define P2P_PEER_MAX          10
#endif
#endif
#ifndef P2P_ROUTER_COUNT
#define P2P_ROUTER_COUNT      0
#endif
#ifndef P2P_ANNOUNCE_MS
#define P2P_ANNOUNCE_MS       5000
#endif
#ifndef P2P_CONNECT_MS
#define P2P_CONNECT_MS        3000
#endif
#ifndef P2P_CONNECT_BACKOFF_MAX_MS
#define P2P_CONNECT_BACKOFF_MAX_MS 30000
#endif
#ifndef P2P_PEER_TIMEOUT_MS
#define P2P_PEER_TIMEOUT_MS   15000
#endif
#ifndef P2P_STATIC_SEED_MAX
#define P2P_STATIC_SEED_MAX   P2P_PEER_MAX
#endif
#ifndef P2P_SEEN_MAX
#ifdef __ZEPHYR__
#define P2P_SEEN_MAX          32
#else
#define P2P_SEEN_MAX          128
#endif
#endif

#define P2P_HELLO        0x01
#define P2P_SUB_NOTIFY   0x02
#define P2P_UNSUB_NOTIFY 0x03
#define P2P_PUBLISH      0x04

typedef struct {
    uint8_t  type;
    uint16_t len;
} __attribute__((packed)) p2p_hdr_t;

typedef enum {
    P2P_ROLE_LEAF = 0,
    P2P_ROLE_ROUTER = 1,
} p2p_role_t;

typedef struct {
    uint8_t  node_id[P2P_NODE_ID_LEN];
    uint16_t mqtt_port;
    uint16_t p2p_port;
    int32_t  score;
    uint8_t  role;
} __attribute__((packed)) p2p_announce_t;

typedef struct {
    uint8_t  node_id[P2P_NODE_ID_LEN];
    uint32_t addr;
    uint16_t mqtt_port;
    uint16_t p2p_port;
    int32_t  score;
    uint8_t  role;
    int64_t  last_seen_ms;
    uint8_t  in_use;
} p2p_peer_score_t;

typedef struct {
    uint8_t remote_nodes;
    uint16_t remote_subs;
    uint16_t exact_routes;
    uint16_t wildcard_routes;
} p2p_router_stats_t;

typedef struct {
    uint8_t  owner_id[P2P_NODE_ID_LEN];
    char     filter[MQTT_TOPIC_MAX];
    uint8_t  qos;
} __attribute__((packed)) p2p_sub_msg_t;

typedef struct {
    uint8_t  node_id[P2P_NODE_ID_LEN];
    uint32_t addr;
    uint16_t p2p_port;
    uint8_t  role;
    uint8_t  outbound;
} p2p_peer_snapshot_t;

typedef struct {
    uint8_t  origin_id[P2P_NODE_ID_LEN];
    uint16_t seq;
    char     topic[MQTT_TOPIC_MAX];
    uint16_t payload_len;
    uint8_t  qos;
    uint8_t  retain;
    uint8_t  payload[MQTT_PAYLOAD_MAX];
} __attribute__((packed)) p2p_publish_msg_t;

/*
 * Dynamic P2P lifecycle.
 *
 * p2p_start() initializes election/router state and starts discovery plus peer
 * transport. It is normally called by broker_run() when
 * CONFIG_MQTT_P2P_DYNAMIC is enabled. Applications embedding the broker should
 * not call these functions unless they are replacing the default broker
 * lifecycle.
 */
void p2p_start(void);
void p2p_peer_start(void);

/*
 * Copy currently connected P2P TCP peers into out. The caller supplies storage
 * and capacity; the return value is the number of entries written. Snapshot
 * data is copied while holding the peer table lock and remains valid after the
 * call returns.
 */
int p2p_peer_snapshot(p2p_peer_snapshot_t *out, int max);

/*
 * Static seed configuration for networks where UDP discovery is unavailable.
 * Call these before p2p_start()/broker_run(). addr is an IPv4 address in
 * network byte order, matching struct sockaddr_in.sin_addr.s_addr.
 * p2p_static_seed_add() returns 0 on success or -1 when inputs are invalid or
 * the fixed seed table is full.
 */
void p2p_static_seed_clear(void);
int p2p_static_seed_add(uint32_t addr, uint16_t p2p_port);

/*
 * Local MQTT event hooks. topic.c calls these when local subscriptions or
 * publishes change so peers can maintain remote routing state. Arguments are
 * copied into fixed-size P2P messages before transmission.
 */
void p2p_local_subscribe(const char *filter, uint8_t qos);
void p2p_local_unsubscribe(const char *filter);
void p2p_resync_local_subscriptions(void);
void p2p_publish_from_local(const mqtt_publish_t *pub);

/*
 * Peer forwarding helpers used by router/peer internals. exclude_node_id may be
 * NULL; when set, that node is skipped to avoid sending a message back to the
 * peer it arrived from.
 */
void p2p_send_publish_from_router(const p2p_publish_msg_t *msg,
                                  const uint8_t *exclude_node_id);
void p2p_send_sub_to_routers(const p2p_sub_msg_t *msg, uint8_t type,
                             const uint8_t *exclude_node_id);

/*
 * Router election state. Snapshot/build functions copy current state into
 * caller-provided storage and return counts or derived values; they do not
 * expose internal arrays.
 */
void p2p_election_init(const uint8_t node_id[P2P_NODE_ID_LEN]);
void p2p_election_update_self(void);
void p2p_election_update_peer(const p2p_announce_t *ann, uint32_t addr);
void p2p_election_record_publish(void);
p2p_role_t p2p_election_role(void);
uint32_t p2p_election_topology_sig(void);
int p2p_election_snapshot(p2p_peer_score_t *out, int max);
void p2p_election_build_announce(p2p_announce_t *out);
void p2p_election_self_id(uint8_t out[P2P_NODE_ID_LEN]);
int p2p_election_peer_budget(int active_nodes);

/*
 * Remote subscription router. These functions maintain and query the fixed P2P
 * route table used to forward publishes toward peers with matching
 * subscriptions. Return values are 0 on success or negative when the fixed
 * route table cannot accept the update.
 */
int p2p_router_remote_subscribe(const uint8_t owner_id[P2P_NODE_ID_LEN],
                                const char *filter, uint8_t qos,
                                const uint8_t next_hop_id[P2P_NODE_ID_LEN]);
int p2p_router_remote_unsubscribe(const uint8_t owner_id[P2P_NODE_ID_LEN],
                                  const char *filter);
void p2p_router_remove_node(const uint8_t owner_id[P2P_NODE_ID_LEN]);
int p2p_router_stats(p2p_router_stats_t *out);
void p2p_router_init(void);
int p2p_router_find_next_hops(const char *topic,
                              const uint8_t *exclude_node_id,
                              uint8_t out[][P2P_NODE_ID_LEN],
                              int max);
void p2p_router_publish(const p2p_publish_msg_t *msg,
                        const uint8_t *exclude_node_id);

#endif /* P2P_H */
```

## include/p2p_shard.h
```c
#ifndef P2P_SHARD_H
#define P2P_SHARD_H

#include "p2p.h"

void p2p_shard_key_from_topic(const char *topic, char out[MQTT_TOPIC_MAX]);
void p2p_shard_key_from_filter(const char *filter, char out[MQTT_TOPIC_MAX]);
int  p2p_shard_owner_for_topic(const char *topic, uint8_t out[P2P_NODE_ID_LEN]);
int  p2p_shard_owner_for_filter(const char *filter, uint8_t out[P2P_NODE_ID_LEN]);
int  p2p_shard_is_local_owner_for_topic(const char *topic);
int  p2p_shard_is_local_owner_for_filter(const char *filter);

#endif /* P2P_SHARD_H */
```

## include/packet.h
```c
#ifndef PACKET_H
#define PACKET_H

#include <stdint.h>
#include <stddef.h>

/* MQTT v3.1.1 packet type (high nibble of first byte) */
#define MQTT_CONNECT      0x10
#define MQTT_CONNACK      0x20
#define MQTT_PUBLISH      0x30
#define MQTT_PUBACK       0x40
#define MQTT_PUBREC       0x50
#define MQTT_PUBREL       0x60
#define MQTT_PUBCOMP      0x70
#define MQTT_SUBSCRIBE    0x80
#define MQTT_SUBACK       0x90
#define MQTT_UNSUBSCRIBE  0xA0
#define MQTT_UNSUBACK     0xB0
#define MQTT_PINGREQ      0xC0
#define MQTT_PINGRESP     0xD0
#define MQTT_DISCONNECT   0xE0

/* CONNACK return codes */
#define CONNACK_ACCEPTED          0x00
#define CONNACK_UNACCEPTABLE_PROTO 0x01
#define CONNACK_ID_REJECTED       0x02
#define CONNACK_SERVER_UNAVAIL    0x03
#define CONNACK_BAD_CREDENTIALS   0x04
#define CONNACK_NOT_AUTHORIZED    0x05

#define MQTT_CLIENT_ID_MAX   24
#define MQTT_USERNAME_MAX    64
#define MQTT_PASSWORD_MAX    64
#define MQTT_TOPIC_MAX       128
#define MQTT_PAYLOAD_MAX     512
#define MQTT_MAX_PACKET_SIZE (MQTT_TOPIC_MAX + MQTT_PAYLOAD_MAX + 64)

/* raw packet buffer received from wire */
typedef struct {
    uint8_t  type_flags;    /* first byte: type | flags */
    uint32_t remaining_len;
    uint8_t  buf[MQTT_MAX_PACKET_SIZE];
    uint32_t buf_len;       /* bytes in buf (== remaining_len when complete) */
} mqtt_packet_t;

typedef struct {
    char     client_id[MQTT_CLIENT_ID_MAX];
    uint8_t  clean_session;
    uint16_t keepalive;
    uint8_t  has_will;
    char     will_topic[MQTT_TOPIC_MAX];
    uint8_t  will_payload[256];
    uint16_t will_payload_len;
    uint8_t  will_qos;
    uint8_t  will_retain;
    uint8_t  has_username;
    uint8_t  has_password;
    char     username[MQTT_USERNAME_MAX];
    char     password[MQTT_PASSWORD_MAX];
} mqtt_connect_t;

typedef struct {
    char     topic[MQTT_TOPIC_MAX];
    uint8_t  payload[MQTT_PAYLOAD_MAX];
    uint16_t payload_len;
    uint8_t  qos;
    uint8_t  retain;
    uint8_t  dup;
    uint16_t packet_id;   /* only valid for qos > 0 */
} mqtt_publish_t;

/* decode/encode MQTT variable-length remaining-length field */
int packet_decode_remaining_len(const uint8_t *buf, size_t buf_len,
                                 uint32_t *out_len, size_t *out_bytes);
int packet_encode_remaining_len(uint32_t len, uint8_t *out, size_t *out_bytes);

/* parse incoming packets */
int packet_parse_connect(const mqtt_packet_t *pkt, mqtt_connect_t *out);
int packet_parse_publish(const mqtt_packet_t *pkt, mqtt_publish_t *out);
int packet_parse_subscribe(const mqtt_packet_t *pkt,
                            uint16_t *packet_id,
                            char topics[][MQTT_TOPIC_MAX],
                            uint8_t *qos, uint8_t *count, uint8_t max_topics);
int packet_parse_unsubscribe(const mqtt_packet_t *pkt,
                              uint16_t *packet_id,
                              char topics[][MQTT_TOPIC_MAX],
                              uint8_t *count, uint8_t max_topics);

/* build outgoing packets; return byte count or negative on error */
int packet_build_connack(uint8_t session_present, uint8_t return_code,
                          uint8_t *out, size_t out_cap);
int packet_build_suback(uint16_t packet_id,
                         const uint8_t *return_codes, uint8_t count,
                         uint8_t *out, size_t out_cap);
int packet_build_unsuback(uint16_t packet_id, uint8_t *out, size_t out_cap);
int packet_build_publish(const mqtt_publish_t *pub, uint8_t *out, size_t out_cap);
int packet_build_puback(uint16_t packet_id, uint8_t *out, size_t out_cap);
int packet_build_pubrec(uint16_t packet_id, uint8_t *out, size_t out_cap);
int packet_build_pubrel(uint16_t packet_id, uint8_t *out, size_t out_cap);
int packet_build_pubcomp(uint16_t packet_id, uint8_t *out, size_t out_cap);
int packet_build_pingresp(uint8_t *out, size_t out_cap);

#endif /* PACKET_H */
```

## include/session.h
```c
#ifndef SESSION_H
#define SESSION_H

#include <stdint.h>
#include "packet.h"
#include "broker.h"

#define SESSION_MAX       MQTT_MAX_CLIENTS
/* Holds offline messages + QoS1 inflights saved on disconnect (CLIENT_INFLIGHT_MAX=4) */
#define SESSION_QUEUE_MAX 8
#define SESSION_SUB_MAX   4   /* max persisted subscriptions per session    */

typedef struct {
    char     topic[MQTT_TOPIC_MAX];
    uint8_t  payload[MQTT_PAYLOAD_MAX];
    uint16_t payload_len;
    uint8_t  qos;
    uint16_t packet_id;
    uint8_t  dup;    /* 1 if retransmit (was inflight when client disconnected) */
    uint8_t  in_use;
} session_msg_t;

typedef struct {
    char          client_id[MQTT_CLIENT_ID_MAX];
    uint8_t       in_use;
    uint8_t       offline;          /* 1 while client is disconnected */
    uint16_t      next_packet_id;   /* for assigning ids to queued msgs */
    char          sub_filters[SESSION_SUB_MAX][MQTT_TOPIC_MAX];
    uint8_t       sub_qos[SESSION_SUB_MAX];
    uint8_t       sub_count;
    session_msg_t queue[SESSION_QUEUE_MAX];
} session_t;

struct client; /* forward declaration — avoids pulling in client.h */

/*
 * Persistent-session lifecycle.
 *
 * session_init() clears the fixed session pool and must run during broker
 * initialization. Sessions are keyed by MQTT client_id and are used only for
 * clients that connect with clean_session=0. All functions copy caller data
 * into broker-owned fixed buffers; no heap ownership is transferred.
 */
void       session_init(void);
session_t *session_find(const char *client_id);
session_t *session_create(const char *client_id);

/*
 * Find an existing session or create a new one in one lock+scan.
 * Sets *was_found, when non-NULL, to 1 if found or 0 if created. Returns NULL
 * when the fixed session pool is full.
 */
session_t *session_find_or_create(const char *client_id, uint8_t *was_found);
void       session_delete(const char *client_id);

/*
 * Save a disconnected persistent client's current subscription list. The list
 * is clamped to SESSION_SUB_MAX and marks the session offline.
 */
void session_save_subs(session_t *s,
                       const char (*filters)[MQTT_TOPIC_MAX],
                       const uint8_t *qos, uint8_t count);

/*
 * Enqueue one QoS 1/2 message for later delivery. pkt_id is the packet id to
 * use when retransmitting saved inflight messages; use 0 for freshly queued
 * offline publishes so drain can allocate a new id. Returns 0 on success or -1
 * when the fixed queue is full.
 */
int  session_enqueue(session_t *s, const mqtt_publish_t *pub, uint16_t pkt_id);

/* Deliver all queued messages to a freshly reconnected persistent client. */
void session_drain(session_t *s, struct client *c);

/*
 * Iterate offline sessions and enqueue pub for each matching persisted filter.
 * QoS 0 messages are intentionally skipped. Returns the number of sessions that
 * accepted a queued message.
 */
int  session_offline_publish(const mqtt_publish_t *pub,
                              int (*match_fn)(const char *, const char *));

#endif /* SESSION_H */
```

## include/topic.h
```c
#ifndef TOPIC_H
#define TOPIC_H

#include <stdint.h>
#include "packet.h"
#include "broker.h"

/* forward declaration — include client.h in .c files */
struct client;

#ifndef TOPIC_MAX_SUBS
#define TOPIC_MAX_SUBS   (MQTT_MAX_CLIENTS * 8)
#endif
#define TOPIC_RETAIN_MAX 8

typedef struct {
    char    filter[MQTT_TOPIC_MAX];
    char    client_id[MQTT_CLIENT_ID_MAX];
    uint8_t qos;
} sub_snapshot_t;

typedef struct {
    char     topic[MQTT_TOPIC_MAX];
    uint16_t payload_len;
    uint8_t  qos;
} retain_snapshot_t;

/*
 * Snapshot APIs for dashboards and embedders.
 *
 * The caller supplies an output array and capacity. Functions return the number
 * of entries written. topic_get_sub_snapshots_from() advances *cursor so a
 * caller can page through the subscription table without exposing internal
 * storage. Returned strings are copies and remain valid after the call.
 */
int topic_get_sub_snapshots(sub_snapshot_t *out, int max);
int topic_get_sub_snapshots_from(sub_snapshot_t *out, int max, int *cursor);
int topic_get_retain_snapshots(retain_snapshot_t *out, int max);

/*
 * Topic table lifecycle.
 *
 * topic_init() clears subscriptions, retained messages, and routing indexes.
 * Call it once during broker initialization before accepting clients. The
 * remaining functions are thread-safe internally and are normally called from
 * client/session/P2P code, not directly from application tasks.
 */
void topic_init(void);

/*
 * Validate an MQTT topic filter for SUBSCRIBE. Returns 1 for a valid filter and
 * 0 for invalid wildcard placement or an empty filter.
 */
int  topic_filter_valid(const char *filter);

/*
 * Add, update, or remove local subscriptions for a connected client. QoS must
 * already be validated as 0, 1, or 2. topic_subscribe() returns 0 on success or
 * -1 if the fixed subscription table is full.
 */
int  topic_subscribe(struct client *c, const char *filter, uint8_t qos);
int  topic_unsubscribe(struct client *c, const char *filter);
void topic_unsubscribe_all(struct client *c);
int  topic_filter_subscriber_count(const char *filter);

/*
 * Publish into the local topic router. topic_publish() is used for local MQTT
 * clients and retained-store updates; topic_publish_remote() is used for P2P
 * ingress and avoids re-advertising the message back to peers.
 */
int  topic_publish(const mqtt_publish_t *pub);
int  topic_publish_remote(const mqtt_publish_t *pub);

/*
 * Deliver retained messages matching filter to a subscriber after SUBACK has
 * been sent. The delivered QoS is min(requested QoS, retained publish QoS).
 */
void topic_deliver_retained(struct client *c, const char *filter, uint8_t qos);

/* Write up to max of client c's subscriptions into out/out_qos; returns count. */
int  topic_get_client_subs(struct client *c,
                            char out[][MQTT_TOPIC_MAX],
                            uint8_t *out_qos, uint8_t max);

#endif /* TOPIC_H */
```

## include/wifi.h
```c
#ifndef WIFI_H
#define WIFI_H

#ifdef __ZEPHYR__
/*
 * Zephyr standalone helper.
 *
 * Connect to WiFi and obtain an IP address before broker_init() is called.
 * Blocks until connected or returns a negative error code on failure. Product
 * embedders may use their own network bring-up instead of this helper.
 */
int wifi_connect(void);
#endif

#endif /* WIFI_H */
```

## src/http.c
```c
#ifndef __ZEPHYR__

#include <stdio.h>
#include <stdlib.h>
#include <string.h>
#include <stdint.h>
#include <unistd.h>
#include <pthread.h>
#include <sys/socket.h>
#include <netinet/in.h>
#include <errno.h>

#include "http.h"
#include "broker.h"
#include "client.h"
#include "topic.h"
#include "packet.h"
#include "platform/platform.h"

/* ── embedded dashboard HTML ───────────────────────────────────────────────── */

static const char DASHBOARD[] =
"<!DOCTYPE html>\n"
"<html lang=\"en\"><head>\n"
"<meta charset=\"UTF-8\">\n"
"<meta name=\"viewport\" content=\"width=device-width,initial-scale=1\">\n"
"<title>MQTT Broker</title>\n"
"<style>\n"
"body{font-family:sans-serif;margin:24px;background:#f0f2f5;color:#222}\n"
"h1{margin-bottom:4px}h2{color:#444;border-bottom:1px solid #ccc;padding-bottom:4px}\n"
"table{border-collapse:collapse;width:100%;background:#fff;margin-bottom:20px;border-radius:6px;overflow:hidden;box-shadow:0 1px 3px rgba(0,0,0,.1)}\n"
"th,td{border:1px solid #e0e0e0;padding:8px 14px;text-align:left}\n"
"th{background:#4a90e2;color:#fff;font-weight:600}\n"
"tr:nth-child(even){background:#f7f9fc}\n"
".bar{display:flex;gap:16px;margin-bottom:16px;flex-wrap:wrap}\n"
".card{background:#fff;border-radius:6px;padding:12px 18px;box-shadow:0 1px 3px rgba(0,0,0,.1);min-width:120px}\n"
".card span{display:block;font-size:22px;font-weight:700;color:#4a90e2}\n"
".card small{color:#888;font-size:12px}\n"
".dot{width:10px;height:10px;border-radius:50%;display:inline-block;background:#ccc;margin-right:6px;vertical-align:middle}\n"
".ok{background:#4caf50}.err{background:#f44336}\n"
".row{display:flex;gap:8px;align-items:center;margin-bottom:8px}\n"
"input,select{padding:7px 10px;border:1px solid #ccc;border-radius:4px;font-size:14px}\n"
"button{padding:7px 18px;background:#4a90e2;color:#fff;border:none;border-radius:4px;cursor:pointer;font-size:14px}\n"
"button:hover{background:#357abd}\n"
"#msg{font-size:13px;color:#4caf50;margin-left:8px}\n"
"</style></head>\n"
"<body>\n"
"<h1>MQTT Broker Dashboard</h1>\n"
"<div style=\"margin-bottom:12px\"><span class=\"dot\" id=\"dot\"></span><span id=\"ts\" style=\"color:#888;font-size:13px\"></span></div>\n"
"<div class=\"bar\">\n"
"  <div class=\"card\"><span id=\"v-up\">—</span><small>Uptime (s)</small></div>\n"
"  <div class=\"card\"><span id=\"v-cl\">—</span><small>Clients</small></div>\n"
"  <div class=\"card\"><span id=\"v-sb\">—</span><small>Subscriptions</small></div>\n"
"  <div class=\"card\"><span id=\"v-rt\">—</span><small>Retained</small></div>\n"
"</div>\n"
"<h2>Connected Clients</h2>\n"
"<table><thead><tr><th>Slot</th><th>Client ID</th><th>Keepalive (s)</th><th>Idle (ms)</th></tr></thead>\n"
"<tbody id=\"tb-c\"></tbody></table>\n"
"<h2>Subscriptions</h2>\n"
"<table><thead><tr><th>Filter</th><th>Client ID</th><th>QoS</th></tr></thead>\n"
"<tbody id=\"tb-s\"></tbody></table>\n"
"<h2>Retained Messages</h2>\n"
"<table><thead><tr><th>Topic</th><th>Payload (bytes)</th><th>QoS</th></tr></thead>\n"
"<tbody id=\"tb-r\"></tbody></table>\n"
"<h2>Publish</h2>\n"
"<div class=\"row\">\n"
"  <input id=\"p-topic\" placeholder=\"topic\" style=\"width:180px\">\n"
"  <input id=\"p-payload\" placeholder=\"payload\" style=\"width:240px\">\n"
"  <select id=\"p-qos\"><option value=\"0\">QoS 0</option><option value=\"1\">QoS 1</option><option value=\"2\">QoS 2</option></select>\n"
"  <button onclick=\"pub()\">Publish</button>\n"
"  <span id=\"msg\"></span>\n"
"</div>\n"
"<script>\n"
"var dot=document.getElementById('dot');\n"
"function tbl(id,rows,keys){\n"
"  var b=document.getElementById(id);b.innerHTML='';\n"
"  if(!rows.length){var r=document.createElement('tr'),d=document.createElement('td');\n"
"    d.colSpan=keys.length;d.style.color='#aaa';d.style.textAlign='center';\n"
"    d.textContent='(none)';r.appendChild(d);b.appendChild(r);return;}\n"
"  rows.forEach(function(row){\n"
"    var r=document.createElement('tr');\n"
"    keys.forEach(function(k){var d=document.createElement('td');d.textContent=row[k]!=null?row[k]:'';r.appendChild(d);});\n"
"    b.appendChild(r);});\n"
"}\n"
"function refresh(){\n"
"  fetch('/api/status').then(function(r){return r.json();}).then(function(d){\n"
"    dot.className='dot ok';\n"
"    document.getElementById('ts').textContent=new Date().toLocaleTimeString();\n"
"    document.getElementById('v-up').textContent=Math.floor(d.uptime_ms/1000);\n"
"    document.getElementById('v-cl').textContent=d.clients.length;\n"
"    document.getElementById('v-sb').textContent=d.subscriptions.length;\n"
"    document.getElementById('v-rt').textContent=d.retained.length;\n"
"    tbl('tb-c',d.clients,['slot','client_id','keepalive','idle_ms']);\n"
"    tbl('tb-s',d.subscriptions,['filter','client_id','qos']);\n"
"    tbl('tb-r',d.retained,['topic','payload_len','qos']);\n"
"  }).catch(function(){dot.className='dot err';});\n"
"}\n"
"function pub(){\n"
"  var t=document.getElementById('p-topic').value;\n"
"  var p=document.getElementById('p-payload').value;\n"
"  var q=parseInt(document.getElementById('p-qos').value);\n"
"  if(!t){document.getElementById('msg').textContent='Topic required';return;}\n"
"  fetch('/api/publish',{method:'POST',headers:{'Content-Type':'application/json'},\n"
"    body:JSON.stringify({topic:t,payload:p,qos:q})})\n"
"  .then(function(r){return r.json();})\n"
"  .then(function(d){\n"
"    var m=document.getElementById('msg');\n"
"    m.textContent=d.ok?'Published ✓':'Error: '+d.error;\n"
"    m.style.color=d.ok?'#4caf50':'#f44336';\n"
"    setTimeout(function(){m.textContent='';},2000);\n"
"  }).catch(function(){document.getElementById('msg').textContent='Request failed';});\n"
"}\n"
"setInterval(refresh,2000);refresh();\n"
"</script></body></html>\n";

/* ── HTTP helpers ───────────────────────────────────────────────────────────── */

static int http_send_all(int fd, const void *buf, size_t len)
{
    const uint8_t *p = (const uint8_t *)buf;

    while (len > 0) {
        ssize_t n = send(fd, p, len, 0);
        if (n <= 0) {
            return -1;
        }
        p += n;
        len -= (size_t)n;
    }
    return 0;
}

static int http_recv_all(int fd, char *buf, size_t len)
{
    size_t done = 0;

    while (done < len) {
        ssize_t n = recv(fd, buf + done, len - done, 0);
        if (n <= 0) {
            return -1;
        }
        done += (size_t)n;
    }
    return 0;
}

static void http_send(int fd, int code, const char *ctype,
                      const char *body, size_t blen)
{
    char hdr[256];
    const char *reason = (code == 200) ? "OK" :
                         (code == 400) ? "Bad Request" : "Not Found";
    int hlen = snprintf(hdr, sizeof(hdr),
        "HTTP/1.1 %d %s\r\n"
        "Content-Type: %s\r\n"
        "Content-Length: %zu\r\n"
        "Access-Control-Allow-Origin: *\r\n"
        "Connection: close\r\n"
        "\r\n", code, reason, ctype, blen);
    if (hlen < 0 || (size_t)hlen >= sizeof(hdr)) {
        return;
    }
    if (http_send_all(fd, hdr, (size_t)hlen) < 0) {
        return;
    }
    if (blen) {
        (void)http_send_all(fd, body, blen);
    }
}

/* locate the value portion of "key": <value> in a JSON string */
static const char *json_find_value(const char *json, const char *key)
{
    char search[72];
    snprintf(search, sizeof(search), "\"%s\":", key);
    const char *p = strstr(json, search);
    if (!p) return NULL;
    p += strlen(search);
    while (*p == ' ') p++;
    return p;
}

static int json_str(const char *json, const char *key, char *out, size_t cap)
{
    const char *p = json_find_value(json, key);
    if (!p || *p != '"') return -1;
    p++;
    size_t i = 0;
    while (*p && *p != '"' && i < cap - 1) out[i++] = *p++;
    out[i] = '\0';
    return 0;
}

static int json_int(const char *json, const char *key)
{
    const char *p = json_find_value(json, key);
    return p ? atoi(p) : 0;
}

/* ── request handlers ───────────────────────────────────────────────────────── */

static void handle_status(int fd)
{
    client_snapshot_t  cs[MQTT_MAX_CLIENTS];
    sub_snapshot_t     ss[TOPIC_MAX_SUBS];
    retain_snapshot_t  rs[TOPIC_MAX_SUBS];

    int nc = client_get_snapshots(cs, MQTT_MAX_CLIENTS);
    int ns = topic_get_sub_snapshots(ss, TOPIC_MAX_SUBS);
    int nr = topic_get_retain_snapshots(rs, TOPIC_MAX_SUBS);

    int64_t now = plat_uptime_ms();
    char buf[8192];
    int  pos = 0;

#define APPEND(fmt, ...) pos += snprintf(buf + pos, (int)sizeof(buf) - pos, fmt, ##__VA_ARGS__)

    APPEND("{\"uptime_ms\":%lld", (long long)now);

    APPEND(",\"clients\":[");
    for (int i = 0; i < nc; i++) {
        if (i) APPEND(",");
        APPEND("{\"slot\":%d,\"client_id\":\"%s\",\"keepalive\":%d,\"idle_ms\":%lld}",
               cs[i].slot, cs[i].client_id, cs[i].keepalive,
               (long long)(now - cs[i].last_seen_ms));
    }
    APPEND("]");

    APPEND(",\"subscriptions\":[");
    for (int i = 0; i < ns; i++) {
        if (i) APPEND(",");
        APPEND("{\"filter\":\"%s\",\"client_id\":\"%s\",\"qos\":%d}",
               ss[i].filter, ss[i].client_id, ss[i].qos);
    }
    APPEND("]");

    APPEND(",\"retained\":[");
    for (int i = 0; i < nr; i++) {
        if (i) APPEND(",");
        APPEND("{\"topic\":\"%s\",\"payload_len\":%d,\"qos\":%d}",
               rs[i].topic, rs[i].payload_len, rs[i].qos);
    }
    APPEND("]}");

#undef APPEND

    http_send(fd, 200, "application/json", buf, (size_t)pos);
}

static void handle_publish_api(int fd, const char *body)
{
    char topic[MQTT_TOPIC_MAX]   = {0};
    char payload[MQTT_PAYLOAD_MAX] = {0};

    if (json_str(body, "topic", topic, sizeof(topic)) < 0 || topic[0] == '\0') {
        http_send(fd, 400, "application/json", "{\"ok\":false,\"error\":\"missing topic\"}", 36);
        return;
    }
    json_str(body, "payload", payload, sizeof(payload));
    int qos = json_int(body, "qos");
    if (qos < 0 || qos > 2) qos = 0;

    mqtt_publish_t pub = {0};
    strncpy(pub.topic, topic, sizeof(pub.topic) - 1);
    pub.payload_len = (uint16_t)strlen(payload);
    memcpy(pub.payload, payload, pub.payload_len);
    pub.qos    = (uint8_t)qos;
    pub.retain = 0;

    topic_publish(&pub);

    http_send(fd, 200, "application/json", "{\"ok\":true}", 11);
}

/* ── connection dispatch ────────────────────────────────────────────────────── */

static void handle_connection(int fd)
{
    char req[4096] = {0};
    int  total     = 0;

    /* read until end of headers (or buffer full) */
    while (total < (int)sizeof(req) - 1) {
        ssize_t n = recv(fd, req + total, sizeof(req) - 1 - (size_t)total, 0);
        if (n <= 0) return;
        total += (int)n;
        if (strstr(req, "\r\n\r\n")) break;
    }

    /* OPTIONS preflight (CORS) */
    if (strncmp(req, "OPTIONS", 7) == 0) {
        http_send(fd, 200, "text/plain", "", 0);
        return;
    }

    /* route on path */
    if (strncmp(req, "GET / ", 6) == 0 || strncmp(req, "GET /\r", 6) == 0) {
        http_send(fd, 200, "text/html; charset=utf-8",
                  DASHBOARD, sizeof(DASHBOARD) - 1);
        return;
    }

    if (strncmp(req, "GET /api/status", 15) == 0) {
        handle_status(fd);
        return;
    }

    if (strncmp(req, "POST /api/publish", 17) == 0) {
        /* find body after \r\n\r\n */
        const char *body = strstr(req, "\r\n\r\n");
        if (body) body += 4;

        /* if body was cut off, read remaining Content-Length bytes */
        int clen = 0;
        const char *cl = strstr(req, "Content-Length:");
        if (!cl) cl = strstr(req, "content-length:");
        if (cl) clen = atoi(cl + 15);

        static char body_buf[MQTT_PAYLOAD_MAX + 256];
        memset(body_buf, 0, sizeof(body_buf));
        if (body) {
            int already = total - (int)(body - req);
            int remain  = clen - already;
            if (already > 0) {
                size_t copy = (size_t)already < sizeof(body_buf) - 1
                              ? (size_t)already : sizeof(body_buf) - 1;
                memcpy(body_buf, body, copy);
            }
            if (remain > 0 && already >= 0) {
                if ((size_t)already + (size_t)remain >= sizeof(body_buf)) {
                    http_send(fd, 400, "application/json",
                              "{\"ok\":false,\"error\":\"body too large\"}", 37);
                    return;
                }
                if (http_recv_all(fd, body_buf + already, (size_t)remain) < 0) {
                    http_send(fd, 400, "application/json",
                              "{\"ok\":false,\"error\":\"truncated body\"}", 39);
                    return;
                }
            }
            /* null-terminator: always within buffer bounds */
            size_t term = (size_t)(already + (remain > 0 ? remain : 0));
            if (term >= sizeof(body_buf))
                term = sizeof(body_buf) - 1;
            body_buf[term] = '\0';
        }
        handle_publish_api(fd, body_buf);
        return;
    }

    http_send(fd, 404, "application/json", "{\"error\":\"not found\"}", 21);
}

/* ── server thread ──────────────────────────────────────────────────────────── */

static int      srv_fd   = -1;
static volatile int running = 0;
static pthread_t http_tid;

static void *http_thread(void *arg)
{
    (void)arg;
    while (running) {
        struct sockaddr_in peer;
        socklen_t plen = sizeof(peer);
        int fd = accept(srv_fd, (struct sockaddr *)&peer, &plen);
        if (fd < 0) {
            if (running) perror("http accept");
            break;
        }
        handle_connection(fd);
        close(fd);
    }
    return NULL;
}

int http_server_start(uint16_t port)
{
    srv_fd = socket(AF_INET, SOCK_STREAM, 0);
    if (srv_fd < 0) return -1;

    int opt = 1;
    setsockopt(srv_fd, SOL_SOCKET, SO_REUSEADDR, &opt, sizeof(opt));

    struct sockaddr_in addr = {
        .sin_family = AF_INET,
        .sin_port   = htons(port),
    };
    if (bind(srv_fd, (struct sockaddr *)&addr, sizeof(addr)) < 0) {
        close(srv_fd); return -1;
    }
    if (listen(srv_fd, 4) < 0) {
        close(srv_fd);
        srv_fd = -1;
        return -1;
    }

    running = 1;
    int rc = pthread_create(&http_tid, NULL, http_thread, NULL);
    if (rc != 0) {
        running = 0;
        close(srv_fd);
        srv_fd = -1;
        return -1;
    }
    printf("[INF] HTTP dashboard on http://0.0.0.0:%u\n", port);
    return 0;
}

void http_server_stop(void)
{
    running = 0;
    if (srv_fd >= 0) { close(srv_fd); srv_fd = -1; }
    pthread_join(http_tid, NULL);
}

#endif /* !__ZEPHYR__ */
```
